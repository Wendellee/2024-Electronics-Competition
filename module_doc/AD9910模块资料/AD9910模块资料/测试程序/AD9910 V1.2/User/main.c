//-----------------------------------------------------------------
// 程序描述: AD9910测试程序
// 作　　者: 凌智电子
// 开始日期: 2020-05-01
// 完成日期: 2020-05-05
// 当前版本: V1.2，增加方波和三角波输出功能
// 历史版本:
//		v1.0:初始版本
//		v1.1:增加并行调制模式
// 调试工具: 凌智STM32核心开发板、2.8寸液晶、LZE_ST_LINK2
// 说　　明: 
//				
//-----------------------------------------------------------------
//												AD9910与STM32F1连接
//						  AD9910                    		STM32F1
//								MRT														PB15
//								CSN														PB14
//								SCK														PB13
//								SDI														PB12
//								IUP														PB11
//								DRH														PB10
//								DRC														PB9
//								PF0														PB8
//								PF1														PA7
//								PF2														PA6
//								OSK														PC7
//
//								GND														JGND
//
//			其中 	DRG功能也可以外接控制信号来控制    控制引脚为 DRC	   DRH
//			 			OSK功能也可以外界控制信号来控制    控制引脚为 OSK
// 如果需要进行并行调制模式, 则还需要对模块的P1接口进行连接
// 不需要并行调制模式, 不需要连接以下P1接口（模式的）

//								F0														PA5
//								F1														PA4
//								D0														PA3
//								D1														PA2
//								D2														PA1
//								D3														PA0
//								D4														PC5
//								D5														PC4
//								D6														PC3
//								D7														PC2
//								D8														PC1
//								D9														PC0
//								D10														PC8
//								D11														PC9
//								D12														PC10
//								D13														PC11
//								D14														PC12
//								D15														PC13
//
//
//-----------------------------------------------------------------
// 头文件包含
//-----------------------------------------------------------------
#include <stm32f10x.h>
#include "Delay.h"
#include "string.h"
#include "PeripheralInit.h"
#include "AD9910.h"
#include "key.h" 
#include "lze_lcd.h"
#include "stdio.h"
#include "fonts.h"

unsigned char static DataStr[]=__DATE__;
unsigned char static TimeStr[]=__TIME__;

u8 key_numb;											// 按键标志位
u8 numb=0;												// 标志位
u8 NB=0;													// AD9910功能标志位
u8 buf[10];												// 显示数组
int i;														// 循环标志位（验证用的）

// 初始化的单频频率
uint32_t fre_data[] = {0, 1, 10, 100, 500, 1000, 5000, 10000, 50000, 100000, 500000, 1000000, 5000000, 10000000, 50000000, 100000000, 200000000, 300000000, 380000000, 400000000, 420000000};
// 初始化的单频幅度
int amp_data[] = {0,1023,2047,4095,8191,9215,10239,11263,12287,13311,14335,15359,16383};
// 初始化的单频相位
int pha_data[] = {0,90,180,270,360};

// 并口的偏移量
int offset_fre[64] = {0, 1000, 2000, 4000, 8000, 10000, 20000, 40000, 60000};
// 并口的增益
int gain[64] = {0,1,2,3,4,5,6,7,8,9,10,11,12,13,14,15};
	
//-----------------------------------------------------------------
// int get_data(int pos_fre, int num[])
//-----------------------------------------------------------------
//
//  函数功能: 将num中的数值合成一个数
//  入口参数: pos_fre数组有效位数，num数据存放的数组
//  返回参数: 返回数据值
//  注意事项: 无
//
//-----------------------------------------------------------------
int get_data(int pos_fre, int num[])
{
	int i = 0, data;
	
	data = num[i];
	i++;
	while(i <= pos_fre)
	{
		data = data*10 + num[i];	
		i++;
	}
	
	return data;	
}
//-----------------------------------------------------------------
// void  clr_data(int pos_fre, int num[])
//-----------------------------------------------------------------
// 
//  函数功能: 清除数组里面的数
//  入口参数: pos_fre数组有效位数，num数据存放的数组
//  返回参数: 无
//  注意事项: 无
//
//-----------------------------------------------------------------
void  clr_data(int pos_fre, int num[])
{
	int i = 0;
	
	for(; i <= pos_fre; i++)
	{
		num[i] = 0;
	}
}
//9910扫频参数
typedef struct dds_ad9910
{
	int start_parm;
	int stop_parm;
	int rising_step;
	int falling_step;
	int rising_time;
	int falling_time;
}DDS;
//-----------------------------------------------------------------
// 主程序
//-----------------------------------------------------------------
int main(void)
{
	PeripheralInit();																		// 外设初始化
	AD9910_Init();																			// AD9910时钟的设置和辅助DAC设置 以及AD9910复位
	AD9910_Singal_Profile_Init();
	while(1)
	{
		AD9910_Singal_Profile_Set(0,1000000,16383,0);
	}
	
}

//-----------------------------------------------------------------
// End Of File
//-----------------------------------------------------------------
